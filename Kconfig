## Kconfig
```kconfig
#
# Tup-config configuration
#
mainmenu "Tup-config Configuration"

source conf/Kconfig
source mconf/Kconfig
source nconf/Kconfig
source gconf/Kconfig
source qconf/Kconfig
source zconf/Kconfig
source lxdialog/Kconfig
source config/Kconfig.toolchain
```

## conf/Kconfig
```kconfig
#
# Tup-conf configuration
#
config TUP_CONFIG_CONF
	bool "Enable tup-conf"
	default y
	select TUP_CONFIG_ZCONF
	---help---
	  The 'tup-conf' program provides basic command line configuration.
```

## config/Kconfig.toolchain
```kconfig
#
# Toolchain configuration
#
menu "Toolchain setup"

menu "C compiler"

config CC
	string "C compiler"
	default "gcc"

config CFLAGS
	string "C compiler flags"
	default "-g -O2 -Wall"

endmenu # "C compiler"

menu "C++ compiler"

config CXX
	string "C++ compiler"
	default "g++"

config CXXFLAGS
	string "C++ compiler flags"
	default "-g -O2 -Wall"

endmenu # "C++ compiler"

menu "Archiver"

config AR
	string "Archiver"
	default "ar"

config ARFLAGS
	string "Archiver flags"
	default "rcs"

endmenu # "Archiver"

config LEX
	string "Lexical analyzer generator"
	default "flex"

config YACC
	string "Parser generator"
	default "bison"

config GPERF
	string "Perfect hash function generator"
	default "gperf"

menu "Pkg-config"

config PKG_CONFIG
	string "Package meta data"
	default "pkg-config"

config EXPORT_PKG_CONFIG_PATH
	bool "Export $PKG_CONFIG_PATH"
	default y

config PKG_CONFIG_ENV
	string "Environment variables passed to pkg-config"

endmenu # "Pkg-config"

config MOC
	string "Qt meta object compiler"
	default "moc"

config CROSS_COMPILE
	string "Set the cross-compiler prefix"

endmenu # "Toolchain setup"
```

## gconf/Kconfig
```kconfig
#
# Tup-gconf configuration
#
config TUP_CONFIG_GCONF
	bool "Enable tup-gconf"
	default n
	select TUP_CONFIG_ZCONF
	---help---
	  The 'tup-gconf' program provides Gtk+ configuration.
```

## lxdialog/Kconfig
```kconfig
#
# Lxdialog library configuration
#
config TUP_CONFIG_LXDIALOG
	bool
	default n
	---help---
	  Other packages will select this library if needed.
```

## mconf/Kconfig
```kconfig
#
# Tup-mconf configuration
#
config TUP_CONFIG_MCONF
	bool "Enable tup-mconf"
	default y
	select TUP_CONFIG_ZCONF
	select TUP_CONFIG_LXDIALOG
	---help---
	  The 'tup-mconf' program provides Ncurses configuration.
```

## nconf/Kconfig
```kconfig
#
# Tup-nconf configuration
#
config TUP_CONFIG_NCONF
	bool "Enable tup-nconf"
	default n
	select TUP_CONFIG_ZCONF
	select TUP_CONFIG_LXDIALOG
	---help---
	  The 'tup-nconf' program provides Ncurses configuration.
```

## qconf/Kconfig
```kconfig
#
# Tup-qconf configuration
#
config TUP_CONFIG_QCONF
	bool "Enable tup-qconf"
	default n
	select TUP_CONFIG_ZCONF
	---help---
	  The 'tup-qconf' program provides Qt configuration.
```

## zconf/Kconfig
```kconfig
#
# Zconf library configuration
#
config TUP_CONFIG_ZCONF
	bool
	default n
	---help---
	  Other packages will select this library if needed.
```
